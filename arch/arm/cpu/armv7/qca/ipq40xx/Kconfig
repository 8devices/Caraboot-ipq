## board/ipq40xx/Kconfig
```kconfig
if ARCH_IPQ40xx

config SYS_CPU
	default "ipq40xx"

config SYS_BOARD
	default "ipq40xx"

config SYS_VENDOR
	default "qca/arm"

config SYS_CONFIG_NAME
	default "ipq40xx"

endif
```

## board/ipq5018/Kconfig
```kconfig
if ARCH_IPQ5018

config SYS_CPU
       default "ipq5018"

config SYS_BOARD
       default "ipq5018"

config SYS_VENDOR
       default "qca/arm"

config SYS_CONFIG_NAME
       default "ipq5018"

config IPQ5018_I2C
	bool "Enable i2c support for ipq5018"

config USB_XHCI_IPQ
	bool "Enable usb support for ipq5018"

config PCI_IPQ
	bool "Enable pci support for ipq5018"

endif
```

## board/ipq806x/Kconfig
```kconfig
if ARCH_IPQ806x

config SYS_CPU
	default "ipq806x"

config SYS_BOARD
	default "ipq806x"

config SYS_VENDOR
	default "qca/arm"

config SYS_CONFIG_NAME
	default "ipq806x"

endif
```

## board/ipq807x/Kconfig
```kconfig
config SYS_CPU
       default "ipq807x"

config SYS_BOARD
       default "ipq807x"

config SYS_VENDOR
       default "qca/arm"

config SYS_CONFIG_NAME
       default "ipq807x"

config IPQ807x_I2C
	bool "Enable i2c support for ipq807x"

config USB_XHCI_IPQ
	bool "ipq807x usb support for ipq807x"

config PCI_IPQ
	bool "ipq807x pci support for ipq807x"
```

## board/ipq9048/Kconfig
```kconfig
if ARCH_IPQ9048

config SYS_CPU
       default "ipq9048"

config SYS_BOARD
       default "ipq9048"

config SYS_VENDOR
       default "qca/arm"

config SYS_CONFIG_NAME
       default "ipq9048"

endif
```

## board/ipq9574/Kconfig
```kconfig
if ARCH_IPQ9574

config SYS_CPU
       default "ipq9574"

config SYS_BOARD
       default "ipq9574"

config SYS_VENDOR
       default "qca/arm"

config SYS_CONFIG_NAME
       default "ipq9574"

endif
```

## configs/ipq6018_mango_defconfig
```kconfig
CONFIG_ARM=y
CONFIG_ARCH_IPQ6018=y
CONFIG_USB_XHCI_IPQ=y
CONFIG_PCI_IPQ=y
CONFIG_QCA8081_PHY=y
CONFIG_QCA8075_PHY=y
CONFIG_FIT=y
CONFIG_FIT_VERBOSE=y
CONFIG_SYS_PROMPT="IPQ6018# "
# CONFIG_CMD_BOOTD is not set
# CONFIG_CMD_RUN is not set
# CONFIG_CMD_IMI is not set
# CONFIG_CMD_IMLS is not set
# CONFIG_CMD_XIMG is not set
# CONFIG_CMD_NFS is not set
CONFIG_CMD_PART=y
CONFIG_PARTITION_UUIDS=y
CONFIG_OF_CONTROL=y
CONFIG_USB=y
CONFIG_DM_USB=y
CONFIG_USE_PRIVATE_LIBGCC=y
CONFIG_LZMA=y
```

## configs/qca956x_defconfig
```kconfig
CONFIG_MIPS=y
CONFIG_TARGET_QCA956X=y
CONFIG_SYS_EXTRA_OPTIONS="QCA956X"
CONFIG_SYS_PROMPT="QCA9563# "
# CONFIG_CMD_BDI is not set
# CONFIG_CMD_ELF is not set
# CONFIG_CMD_RUN is not set
# CONFIG_CMD_SAVEENV is not set
# CONFIG_CMD_LOADB is not set
# CONFIG_CMD_LOADS is not set
# CONFIG_CMD_FLASH is not set
# CONFIG_CMD_FPGA is not set
# CONFIG_CMD_SETEXPR is not set
CONFIG_USE_PRIVATE_LIBGCC=y
CONFIG_SYS_MALLOC_F_LEN=0x200
CONFIG_SYS_MALLOC_F=y
```
