/*
 * Copyright (c) 2016 - 2018, The Linux Foundation. All rights reserved.
 *
 * This program is free software; you can redistribute it and/or modify
 * it under the terms of the GNU General Public License version 2 and
 * only version 2 as published by the Free Software Foundation.
 *
 * This program is distributed in the hope that it will be useful,
 * but WITHOUT ANY WARRANTY; without even the implied warranty of
 * MERCHANTABILITY or FITNESS FOR A PARTICULAR PURPOSE.  See the
 * GNU General Public License for more details.
 */

/dts-v1/;
#include "ipq807x-soc.dtsi"
#include <dt-bindings/qcom/gpio-ipq807x.h>
/ {
	model ="QCA, IPQ807x-HK09";
	compatible = "qca,ipq807x", "qca,ipq807x-hk09";
	machid = <0x08010008>;
	config_name = "config@hk09";

	aliases {
		console = "/serial@78B3000";
		uart2 = "/serial@78B0000";
		pci0 = "/pci@20000000";
	};
	ess-switch {
		switch_mac_mode = <0x0>;
		switch_mac_mode1 = <0xFF>;
		switch_mac_mode2 = <0xFF>;
	};
};

