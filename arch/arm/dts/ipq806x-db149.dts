/*
 * Copyright (c) 2016, The Linux Foundation. All rights reserved.
 *
 * This program is free software; you can redistribute it and/or modify
 * it under the terms of the GNU General Public License version 2 and
 * only version 2 as published by the Free Software Foundation.
 *
 * This program is distributed in the hope that it will be useful,
 * but WITHOUT ANY WARRANTY; without even the implied warranty of
 * MERCHANTABILITY or FITNESS FOR A PARTICULAR PURPOSE.  See the
 * GNU General Public License for more details.
 */

/dts-v1/;
#include "ipq806x-soc.dtsi"
/ {
	model ="QCA, IPQ806x-DB149";
	compatible = "qca,ipq806x", "qca,ipq806x-DB149";
	machid = <4699>;
	config_name = "config@db149";

	aliases {
		console = "/serial@12490000";
	};

	serial@12490000 {
		status = "ok";
	};
};
